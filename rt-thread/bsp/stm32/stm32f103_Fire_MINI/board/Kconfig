## rt-thread/bsp/stm32/stm32f103_Fire_MINI/board/Kconfig
```kconfig
menu "Hardware Drivers Config"

config SOC_STM32F103RC
    bool
    select SOC_SERIES_STM32F1
    select RT_USING_COMPONENTS_INIT
    select RT_USING_USER_MAIN
    default y

menu "Onboard Peripheral Drivers"

    config BSP_USING_USB_TO_USART
        bool "Enable USB TO USART (uart1)"
        select BSP_USING_UART1
        default y

endmenu

menu "On-chip Peripheral Drivers"

    config BSP_USING_GPIO
        bool "Enable GPIO"
        select RT_USING_PIN
        default y

    config BSP_USING_UART1
        bool "Enable UART1"
        select RT_USING_SERIAL
        default y

    config BSP_USING_SPI1
        bool "Enable SPI1 BUS"
        select RT_USING_SPI
        default y	

    menuconfig BSP_USING_ONCHIP_RTC
        bool "Enable RTC"
        select RT_USING_RTC
        select RT_USING_LIBC
        default n
        if BSP_USING_ONCHIP_RTC
            choice
                prompt "Select clock source"
                default BSP_RTC_USING_LSE

                config BSP_RTC_USING_LSE
                    bool "RTC USING LSE"

                config BSP_RTC_USING_LSI
                    bool "RTC USING LSI"
            endchoice
        endif

    menuconfig BSP_USING_PWM
             bool "Enable pwm"
             default n
             select RT_USING_PWM
             if BSP_USING_PWM
             menuconfig BSP_USING_PWM1
                      bool "Enable timer2 output pwm"
                      default n
                      if BSP_USING_PWM1
                           config BSP_USING_PWN2_CH1
                                  bool "Enable PWM1 channel1"
                                  default n
                      endif
              endif
    
    menuconfig BSP_USING_TIM
             bool "Enable timer"
             default n
             select RT_USING_HWTIMER
             if BSP_USING_TIM
                     config BSP_USING_TIM6
                             bool "Enable TIM6"
                             default n

                     config BSP_USING_TIM7
                             bool "Enable TIM7"
                             default n
              endif

    menuconfig BSP_USING_I2C1
             bool "Enable I2C1 BUS (software simulation)"
             default n
             select RT_USING_I2C
             select RT_USING_I2C_BITOPS
             select RT_USING_PIN
             if BSP_USING_I2C1
                  comment "Notice: PA2 --> 2; PA3 --> 3"
                  config BSP_I2C1_SCL_PIN
                         int "I2C1 scl pin number"
                         range 1 50
                         default 2
                  config BSP_I2C1_SDA_PIN
                         int "I2C1 sda pin number"
                         range 1 50
                         default 3
             endif

    source "../libraries/HAL_Drivers/Kconfig"
       
endmenu

menu "Board extended module Drivers"

endmenu

endmenu
```
